## conf/layer.conf
```bitbake
# We have a conf and classes directory, add to BBPATH
BBPATH .= ":${LAYERDIR}"

# We have recipes-* directories, add to BBFILES
BBFILES += "${LAYERDIR}/recipes-bsp/images/*.bb \
	    ${LAYERDIR}/recipes-bsp/zynq-fsbl/*.bb \
	    $(LAYERDIR)/recipes-bsp/u-boot/*.bb \
            ${LAYERDIR}/recipes-bsp/linux/*.bbappend"

BBFILE_COLLECTIONS += "meta-openmri"
BBFILE_PATTERN_meta-openmri = "^${LAYERDIR}/"
BBFILE_PRIORITY_meta-openmri = "6"

LAYERDEPENDS_meta-openmri = "core"
LAYERSERIES_COMPAT_meta-openmri = "langdale gatesgarth zeus"
```

## conf/machine/redpitaya.conf
```bitbake
#@TYPE: Machine
#@NAME: redpitaya
#@DESCRIPTION: Machine support for Red Pitaya.
#
# This configuration file was based off the zc702 evaluation board configuration file.
#
SOC_VARIANT ?= "7z"

require conf/machine/include/soc-zynq.inc
require conf/machine/include/machine-xilinx-default.inc

#require conf/machine/include/tune-zynq.inc
#require conf/machine/include/machine-xilinx-overrides.inc
#require conf/machine/include/machine-xilinx-default.inc
#require conf/machine/include/machine-xilinx-qemu.inc

MACHINE_FEATURES = "rtc ext2 ext3 vfat usbhost"

# Generate first stage boot loader using custom recipe
# PREFERRED_PROVIDER_virtual/boot-bin = "zynq-fsbl"

# u-boot configuration
UBOOT_MACHINE = "redpitaya_defconfig"
# Don't use u-boot FSBL
# SPL_BINARY = ""

EXTRA_IMAGEDEPENDS += " \
		virtual/boot-bin \
		virtual/bootloader \
		"

SERIAL_CONSOLE = "115200 ttyPS0"

KERNEL_DEVICETREE = "zynq-redpitaya.dtb"

IMAGE_BOOT_FILES += " \
		boot.bin \
		boot.scr \
		"

# Although not fully supported you can run this machine on the mainline QEMU 'xilinx-zynq-a9' machine
IMAGE_CLASSES += "qemuboot"
QB_MEM = "-m 1024"
QB_MACHINE = "-machine xilinx-zynq-a9"
QB_OPT_APPEND = "-nographic -serial null -serial mon:stdio"
QB_NETWORK_DEVICE = "-net nic,netdev=net0,macaddr=@MAC@"

# Xilinx's fork of QEMU has much better results, so let's default to that
# Use qemu-xilinx instead of mainline
PREFERRED_PROVIDER_qemu-helper-native = "qemu-xilinx-helper-native"

IMAGE_CLASSES += "qemuboot-xilinx"
```

## conf/machine/snickerdoodle-black.conf
```bitbake
#@TYPE: Machine
#@NAME: snickerdoodle-black
#@DESCRIPTION: Machine support for krtl snickerdoodle black.
#
# This configuration file was based off the zc702 evaluation board configuration file.
#
SOC_VARIANT ?= "7z"

require conf/machine/include/soc-zynq.inc
require conf/machine/include/machine-xilinx-default.inc


MACHINE_FEATURES = "rtc ext2 ext3 vfat usbhost"

# Generate first stage boot loader using custom recipe
# PREFERRED_PROVIDER_virtual/boot-bin = "zynq-fsbl"

# u-boot configuration
UBOOT_MACHINE = "snickerdoodle_black_defconfig"

EXTRA_IMAGEDEPENDS += " \
		virtual/boot-bin \
		virtual/bootloader \
		"

SERIAL_CONSOLE = "115200 ttyPS0"

KERNEL_DEVICETREE = "zynq-snickerdoodle-black.dtb"

IMAGE_BOOT_FILES += " \
		boot.bin \
		boot.scr \
		"

# Although not fully supported you can run this machine on the mainline QEMU 'xilinx-zynq-a9' machine
IMAGE_CLASSES += "qemuboot"
QB_MEM = "-m 1024"
QB_MACHINE = "-machine xilinx-zynq-a9"
QB_OPT_APPEND = "-nographic -serial null -serial mon:stdio"
QB_NETWORK_DEVICE = "-net nic,netdev=net0,macaddr=@MAC@"

# Xilinx's fork of QEMU has much better results, so let's default to that
# Use qemu-xilinx instead of mainline
PREFERRED_PROVIDER_qemu-helper-native = "qemu-xilinx-helper-native"

IMAGE_CLASSES += "qemuboot-xilinx"
```

## conf/machine/snickerdoodle_black.conf
```bitbake
#@TYPE: Machine
#@NAME: snickerdoodle-black
#@DESCRIPTION: Machine support for krtl snickerdoodle black.
#
# This configuration file was based off the zc702 evaluation board configuration file.
#
SOC_VARIANT ?= "7z"

require conf/machine/include/soc-zynq.inc
require conf/machine/include/machine-xilinx-default.inc

# this require hard-overwrites the HDF_MACHINE, so it should maybe be used
# as guidance, but not included
#require conf/machine/zynq-generic.conf

MACHINE_FEATURES = "rtc ext2 ext3 vfat usbhost"

# Generate first stage boot loader using custom recipe
# PREFERRED_PROVIDER_virtual/boot-bin = "zynq-fsbl"

# u-boot configuration
UBOOT_MACHINE = "snickerdoodle_black_defconfig"

EXTRA_IMAGEDEPENDS += " \
		virtual/boot-bin \
		virtual/bootloader \
		u-boot-zynq-uenv \
		"

SERIAL_CONSOLE = "115200 ttyPS0"

KERNEL_DEVICETREE = "zynq-snickerdoodle_black.dtb"

IMAGE_BOOT_FILES += " \
		boot.bin \
		boot.scr \
		uEnv.txt \
		"

# Although not fully supported you can run this machine on the mainline QEMU 'xilinx-zynq-a9' machine
# IMAGE_CLASSES += "qemuboot"
# QB_MEM = "-m 1024"
#QB_MACHINE = "-machine xilinx-zynq-a9"
#QB_OPT_APPEND = "-nographic -serial null -serial mon:stdio"
#QB_NETWORK_DEVICE = "-net nic,netdev=net0,macaddr=@MAC@"

# Xilinx's fork of QEMU has much better results, so let's default to that
# Use qemu-xilinx instead of mainline
# PREFERRED_PROVIDER_qemu-helper-native = "qemu-xilinx-helper-native"

#IMAGE_CLASSES += "qemuboot-xilinx"
```
